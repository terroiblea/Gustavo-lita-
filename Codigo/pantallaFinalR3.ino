//Código correspondiente a arduino R3
//únicazmente ligado a pantalla, funciona recibiendo señal del arduino R4
//este indica cuando prender y apagar la pantalla

//Bibliotecas de la pantalla
#include <Adafruit_GFX.h>
#include <Adafruit_GC9A01A.h>
#include <SPI.h>

// Pines (ajusta según tu conexión)
#define TFT_CS   10
#define TFT_DC   9
#define TFT_RST  8
#define SIGNAL_PIN A5 
// Pin analógico que recibe la señal del R4

Adafruit_GC9A01A tft(TFT_CS, TFT_DC, TFT_RST);

// Booleano para saber si la imagen ya se dibujó
bool imagenMostrada = false;

// Imagen en blanco y negro (pega tu array aquí)
const unsigned char epd_bitmap_Mesa_de_trabajo_1jjj [] PROGMEM = {
	0x00, 0x00, 0x00, 0x00, 0x00, 0x00, 0x00, 0x00, 0x00, 0x00, 0x00, 0x00, 0x00, 0x00, 0x00, 0x00, 
	0x00, 0x00, 0x00, 0x00, 0x00, 0x00, 0x00, 0x00, 0x00, 0x00, 0x00, 0x00, 0x00, 0x00, 0x00, 0x00, 
	0x00, 0x00, 0x00, 0x00, 0x00, 0x00, 0x00, 0x00, 0x00, 0x00, 0x00, 0x00, 0x00, 0x00, 0x00, 0x00, 
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	0x00, 0x00, 0x00, 0x00, 0x00, 0x00, 0x00, 0x00, 0x00, 0x00, 0x00, 0x00, 0x00, 0x00, 0x00, 0x00
};

//tamaño de imagen
#define IMG_WIDTH  240
#define IMG_HEIGHT 240

//Función para dibujar imagen en blanco y negro
void drawBitmapBW(int16_t x, int16_t y, const unsigned char *bitmap, int16_t w, int16_t h, uint16_t color) {
  int byteWidth = (w + 7) / 8; // cada byte = 8 píxeles
  for (int j = 0; j < h; j++) {
    for (int i = 0; i < w; i++) {
      if (pgm_read_byte(bitmap + j * byteWidth + i / 8) & (128 >> (i & 7))) {
        tft.drawPixel(x + i, y + j, color);
      }
    }
  }
}

void setup() {
  pinMode(SIGNAL_PIN, INPUT); 
	// Configura pin de entrada de señal
  Serial.begin(9600);

  tft.begin();
  tft.setRotation(0);
  tft.fillScreen(GC9A01A_BLACK);

  Serial.println("Pantalla lista, esperando señal...");
}

void loop() {
  int estado = digitalRead(SIGNAL_PIN);  
	// Lee la señal digital desde R4

  // Si recibe señal HIGH muestra la imagen
  if (estado == HIGH && !imagenMostrada) {
    Serial.println("Señal recibida: mostrando imagen");
    drawBitmapBW(0, 0, epd_bitmap_Mesa_de_trabajo_1jjj, IMG_WIDTH, IMG_HEIGHT, GC9A01A_WHITE);
    imagenMostrada = true;
  } 
  // Si recibe señal LOW limpia la pantalla
  else if (estado == LOW && imagenMostrada) {
    Serial.println("Señal apagada: limpiando pantalla");
    tft.fillScreen(GC9A01A_BLACK);
    imagenMostrada = false;
  }

  delay(50); 
	// pequeño retardo para que no se trabe
}